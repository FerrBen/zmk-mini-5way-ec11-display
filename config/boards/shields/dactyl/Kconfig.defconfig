## config/boards/shields/dactyl/Kconfig.defconfig
```kconfig
if SHIELD_DACTYL_RIGHT

config ZMK_KEYBOARD_NAME
    default "Dactyl Mini"

config ZMK_SPLIT_ROLE_CENTRAL
    default y

endif

if SHIELD_DACTYL_LEFT || SHIELD_DACTYL_RIGHT

config ZMK_SPLIT
    default y

endif

if SHIELD_DACTYL_LEFT || SHIELD_DACTYL_RIGHT

if ZMK_DISPLAY

config I2C
    default y

config SSD1306
    default y

endif # ZMK_DISPLAY

endif # SHIELD_DACTYL_LEFT || SHIELD_DACTYL_RIGHT
```
