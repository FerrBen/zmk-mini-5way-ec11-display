#include "dactyl.dtsi"

&kscan0 {
    col-gpios
        = <&pro_micro 20 GPIO_ACTIVE_HIGH>  // col0
        , <&pro_micro 19 GPIO_ACTIVE_HIGH>  // col1
        , <&pro_micro 18 GPIO_ACTIVE_HIGH>  // col2
        , <&pro_micro 15 GPIO_ACTIVE_HIGH>  // col3 (moved from D3, D3 now used for I2C)
        , <&pro_micro 14 GPIO_ACTIVE_HIGH>  // col4 (moved from D2, D2 now used for I2C)
        ;
};
